## arch/arm/mach-fh/Kconfig
```kconfig
if ARCH_FULLHAN

config CPU_FH81
	select CPU_V6
	bool
	
config CPU_WUDANG
	select CPU_V6
	bool
	
config CPU_LINBAO
	select CPU_V6
	bool
	
menu "FullHan Implementations"

comment "FullHan Core Type"

choice
	prompt "Select Fullhan Chip:"
	default ARCH_WUDANG

config ARCH_FH81
	bool "FullHan FH81 based system"
	select CPU_FH81

config ARCH_LINBAO
	bool "FullHan Linbao based system"
	select CPU_LINBAO


config ARCH_WUDANG
	bool "FullHan Wudang based system"
	select CPU_WUDANG

endchoice

comment "FullHan Board Type"

config MACH_FH81
	bool "FullHan FH81 board"
	default ARCH_FH81
	depends on ARCH_FH81
	select MISC_DEVICES
	select I2C
	help
	  Configure this option to specify the whether the board used
	  for development is a FH81 EVM

config MACH_LINBAO_FPGA
	bool "FullHan LINBAO fpga board"
	default ARCH_LINBAO
	depends on ARCH_LINBAO
	select MISC_DEVICES
	select I2C
	help
	  Configure this option to specify the whether the board used
	  for development is a Linbao fpga
	  
config MACH_LINBAO
	bool "FullHan LINBAO board"
	default ARCH_LINBAO
	depends on ARCH_LINBAO
	select MISC_DEVICES
	select I2C
	help
	  Configure this option to specify the whether the board used
	  for development is Linbao

config MACH_WUDANG
	bool "FullHan Wudang board"
	default ARCH_WUDANG
	depends on ARCH_WUDANG
	select MISC_DEVICES
	select I2C
	help
	  Configure this option to specify the whether the board used
	  for development is a Wudang EVM
		  
config MACH_HIK
	bool "HIK FH81 board"
	default n
	depends on ARCH_FH81
	select MISC_DEVICES
	select I2C
	help
	  Configure this option to specify the whether the board used
	  for development is a HIK EVM

config MACH_LINBAO_TESTBOARD
	bool "Linbao Test board"
	default n
	depends on ARCH_LINBAO
	help
	  Configure this option to specify the whether the board used
	  for development is a Linbao Test Board
	  
config MACH_LINBAO_QFN
	bool "Linbao QFN"
	default n
	depends on ARCH_LINBAO
	help
	  LINBAO QFN

config JLINK_DEBUG
	bool "Use jlink to debug kernel."

endmenu

endif
```

## drivers/net/fh_gmac/Kconfig
```kconfig
config FH_GMAC
	tristate "FH 10/100 Ethernet driver"
	select MII
	select PHYLIB
	select CRC32
	depends on NETDEVICES && HAS_IOMEM
	help
	  This is the driver for the Ethernet IPs are built around a
	  Synopsys IP Core.

if FH_GMAC

config FH_GMAC_DA
	bool "FH GMAC DMA arbitration scheme"
	default n
	help
	  Selecting this option, rx has priority over Tx (only for Giga
	  Ethernet device).
	  By default, the DMA arbitration scheme is based on Round-robin
	  (rx:tx priority is 1:1).	  
	  
choice
	prompt "choose PHY chip"
	default FH_GMAC_PHY_RTL8201
	
config FH_GMAC_PHY_RTL8201
	bool "RTL8201"
	help
	  Use RTL8201 as PHY
	  
config FH_GMAC_PHY_TI83848
	bool "TI83848"
	help
	  Use TI83848 as PHY
	  
config FH_GMAC_PHY_IP101G
	bool "IP101G"
	help
	  Use IP101G as PHY
endchoice
endif
```

## drivers/net/wireless/mrvl_8801_sd/wlan_src/Kconfig
```kconfig
config MRVL8801
	tristate "Marvell 8801 sdio wireless cards support"
	depends on MMC
	---help---
	  This module adds support for wireless adapters based on
	  Marvell 8801 chipset.

config FW_PATH
	depends on MRVL8801
	string "Firmware path"
	default "/lib/firmware/mrvl/sd8801_uapsta.bin"
	---help---
	  Can not modify firmware path.
```

## drivers/net/wireless/rtl8189FS_sdio_linux_v4.3.24.4/rtl8189FS_linux_v4.3.24.4_18988.20160812/Kconfig
```kconfig
config RTL8189FS_SD
	tristate "Realtek 8189FS SDIO WiFi"
	depends on MMC
	---help---
	  Help message of RTL8189FS_SD
```
